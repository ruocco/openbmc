## meta-phosphor/conf/distro/openbmc-phosphor.conf
```bitbake
require conf/distro/include/phosphor-base.inc

include conf/machine/${MACHINE}-extra.conf
```

## meta-phosphor/conf/machine/qemuarm-extra.conf
```bitbake
KERNEL_IMAGETYPE = '${@bb.utils.contains("DISTRO_FEATURES", "measured_boot", "fitImage", "zImage", d)}'
IMAGE_INSTALL:append = '${@bb.utils.contains("DISTRO_FEATURES", "measured_boot", " u-boot", "", d)}'
IMAGE_FSTYPES = '${@bb.utils.contains("DISTRO_FEATURES", "measured_boot", "wic", "ext4", d)}'
WKS_FILE = '${@bb.utils.contains("DISTRO_FEATURES", "measured_boot", "efi-bootdisk.wks.in", "", d)}'
UBOOT_OS = '${@bb.utils.contains("DISTRO_FEATURES", "measured_boot", "efi", "linux", d)}'
IMAGE_BOOT_FILES = "${KERNEL_IMAGETYPE};kernel"

UBOOT_ENTRYPOINT = "0x40400000"
UBOOT_LOADADDRESS = "0x40400000"
KERNEL_CLASSES ?= "kernel-fitimage"

# For runqemu
QB_SWTPM = "-chardev socket,id=chrtpm,path=@TPMPATH@ -tpmdev emulator,id=tpm0,chardev=chrtpm -device tpm-tis-device,tpmdev=tpm0"
QB_DEFAULT_BIOS = '${@bb.utils.contains("DISTRO_FEATURES", "measured_boot", "u-boot.bin", "", d)}'
QB_DEFAULT_FSTYPE = '${@bb.utils.contains("DISTRO_FEATURES", "measured_boot", "wic", "", d)}'
QB_DRIVE_TYPE = '${@bb.utils.contains("DISTRO_FEATURES", "measured_boot", "/dev/vda", "", d)}'
```
